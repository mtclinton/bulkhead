## external/package/bulkhead-agent/Config.in
```kconfig
config BR2_PACKAGE_BULKHEAD_AGENT
	bool "bulkhead-agent"
	depends on BR2_PACKAGE_HOST_GO_TARGET_ARCH_SUPPORTS
	help
	  bulkhead minimal agent runtime: a bounded perceive->decide->act loop
	  that runs inside a bulkhead jail, does inference via the bulkhead
	  router, and acts through a small tool set — escalating to the TCB
	  broker (human-gated) when it needs more authority than its jail
	  grants. Pure Go (stdlib only), single static binary, outside the TCB.

	  https://github.com/mtclinton/bulkhead
```

## external/package/bulkhead-collector/Config.in
```kconfig
config BR2_PACKAGE_BULKHEAD_COLLECTOR
	bool "bulkhead-collector"
	depends on BR2_PACKAGE_HOST_GO_TARGET_ARCH_SUPPORTS
	help
	  eBPF observe-only provenance collector (cilium/ebpf) plus the
	  fail-closed boot self-test. Loads a BPF-LSM program, streams events
	  to a hash-chained, Ed25519-signed append-only audit log. Vendored
	  dependencies are committed so the build is fully offline.

	  https://github.com/mtclinton/bulkhead
```

## external/package/bulkhead-router/Config.in
```kconfig
config BR2_PACKAGE_BULKHEAD_ROUTER
	bool "bulkhead-router"
	depends on BR2_PACKAGE_HOST_GO_TARGET_ARCH_SUPPORTS
	help
	  bulkhead request router: an OpenAI-compatible HTTP front door that
	  routes each request to the local llama.cpp server or the Anthropic
	  API per a simple rule. Pure Go (stdlib only), single static binary.

	  https://github.com/mtclinton/bulkhead
```

## external/package/llama-cpp/Config.in
```kconfig
config BR2_PACKAGE_LLAMA_CPP
	bool "llama-cpp (llama-server)"
	depends on BR2_INSTALL_LIBSTDCPP
	depends on BR2_TOOLCHAIN_HAS_THREADS
	help
	  llama.cpp inference server (llama-server), built CPU-only and
	  portable (GGML_NATIVE=OFF) for the bulkhead local inference tier.
	  Exposes an OpenAI-compatible HTTP API; bound to loopback and
	  fronted by bulkhead-router.

	  https://github.com/ggml-org/llama.cpp

comment "llama-cpp needs a toolchain w/ C++, threads"
	depends on !BR2_INSTALL_LIBSTDCPP || !BR2_TOOLCHAIN_HAS_THREADS
```

## external/package/tailscale-bin/Config.in
```kconfig
config BR2_PACKAGE_TAILSCALE_BIN
	bool "tailscale-bin (official static binaries)"
	depends on BR2_x86_64
	help
	  Official prebuilt static Tailscale binaries (tailscaled + tailscale),
	  pinned to a current, audited release. Used instead of Buildroot's
	  in-tree tailscale package, which lags upstream and (at 1.78.1) predates
	  advisory TS-2025-008.

	  https://tailscale.com
```

## meta-bulkhead/conf/layer.conf
```bitbake
# SPDX-License-Identifier: AGPL-3.0-only
BBPATH .= ":${LAYERDIR}"
BBFILES += "${LAYERDIR}/recipes-*/*/*.bb ${LAYERDIR}/recipes-*/*/*.bbappend"

BBFILE_COLLECTIONS += "bulkhead"
BBFILE_PATTERN_bulkhead = "^${LAYERDIR}/"
BBFILE_PRIORITY_bulkhead = "10"

LAYERDEPENDS_bulkhead = "core openembedded-layer rauc"
LAYERSERIES_COMPAT_bulkhead = "scarthgap"
```
